#include <dt-bindings/zmk/matrix_transform.h>

/* Column pins set from multimeter measurements of this board.
 * col0=P0.20  col1=P0.22  col2=P0.24  col3=P1.00  col4=P0.11  col5=P1.04
 */
&kscan0 {
    col-gpios
        = <&gpio0 20 GPIO_ACTIVE_HIGH>
        , <&gpio0 22 GPIO_ACTIVE_HIGH>
        , <&gpio0 24 GPIO_ACTIVE_HIGH>
        , <&gpio1 0  GPIO_ACTIVE_HIGH>
        , <&gpio0 11 GPIO_ACTIVE_HIGH>
        , <&gpio1 4  GPIO_ACTIVE_HIGH>
        ;
};
